/dts-v1/;
/plugin/;

#include <dt-bindings/gpio/gpio.h>
#include <dt-bindings/gpio/aspeed-gpio.h>

/ {
	compatible = "aspeed,ast2500";

	fragment@0 {
		target = <&i2c0>;
		__overlay__ {
			/* virtual eeprom */
			rmca-eeprom {
				compatible = "atmel,24c02";
				reg = <0x39>;
			};
		};
	};
};
