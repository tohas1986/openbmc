/dts-v1/;
/plugin/;

#include <dt-bindings/gpio/gpio.h>
#include <dt-bindings/gpio/aspeed-gpio.h>
#include <dt-bindings/interrupt-controller/irq.h>

/ {
	compatible = "aspeed,ast2400";
	fragment@0 {
		target-path = "/";
		__overlay__ {
			dummy_irq {
				label = "dummy_irq_i0";
				compatible = "dummy,dummy-irq-dts";
				interrupt-parent = <&gpio>;
				interrupts = <ASPEED_GPIO(I, 0) IRQ_TYPE_EDGE_FALLING>;
			};
		  };
	 };
};
