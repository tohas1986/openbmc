## meta-fplus/conf/machine/include/yandex.inc
```bitbake
OBMC_MACHINE_FEATURES += "\
        obmc-host-ipmi \
        obmc-host-state-mgmt \
        obmc-chassis-state-mgmt \
        obmc-bmc-state-mgmt \
        "

PREFERRED_PROVIDER_virtual/obmc-host-ipmi-hw = "phosphor-ipmi-kcs"
#PREFERRED_PROVIDER_virtual/phosphor-led-manager-config-native = "my81-led-manager-config-native"
#PREFERRED_PROVIDER_u-boot-fw-utils ?= "u-boot-fw-utils-aspeed"
PREFERRED_PROVIDER_virtual/obmc-inventory-data = "entity-manager"
PREFERRED_PROVIDER_virtual/obmc-system-mgmt = "packagegroup-yandex-mgmt"
PREFERRED_PROVIDER_virtual/phosphor-led-manager-config-native = "common-led-manager-config-native"

VIRTUAL-RUNTIME_obmc-chassis-state-manager = "x86-power-control-yandex"
VIRTUAL-RUNTIME_obmc-host-state-manager = "x86-power-control-yandex"
VIRTUAL-RUNTIME_obmc-inventory-manager = "entity-manager"

# u-boot-fw-utils-aspeed "

DISTRO_FEATURES:remove = "avahi"
VIRTUAL-RUNTIME_obmc-sensors-hwmon = " "
VIRTUAL-RUNTIME_obmc-dump-monitor = " "

FEATURE_PACKAGES_obmc-health-monitor = ""

IMAGE_INSTALL += " ipmitool bmcweb screen sh-functions lmsensors-sensors "
IMAGE_INSTALL += " intel-ipmi-oem board-setup strace tcpdump lpc-cmds"
IMAGE_INSTALL += " netbase "
IMAGE_INSTALL += " usbnet-start lldp-forwarder "
IMAGE_INSTALL += " phosphor-ipmi-flash phosphor-logging phosphor-dbus-interfaces phosphor-ipmi-config phosphor-ipmi-net phosphor-ipmi-kcs default-fru "
IMAGE_INSTALL += " yandex-ipmi-oem phosphor-sel-logger phosphor-ipmi-ipmb curl dmidecode phosphor-host-postd admin-user phosphor-watchdog "
IMAGE_INSTALL += " phosphor-snmp virtual-media ntp ntp-utils ntpdate dbus-checker "
IMAGE_INSTALL += " phosphor-post-code-manager x86-power-control-yandex smbios-mdr webui-vue jq ethtool srvcfg-manager "
IMAGE_INSTALL += " phosphor-led-manager phosphor-pid-control "
IMAGE_INSTALL += " phosphor-ipmi-host dbus-sensors libpeci iotools openocd"
IMAGE_INSTALL += " peci-pcie"
IMAGE_INSTALL += " dimm-serial"

# FIXME Must be removed after IPv4 address configured
# IMAGE_INSTALL += " ampere-openocd "
IMAGE_INSTALL += " inventory-job mtd-utils-jffs2 config-saver id-button "
IMAGE_INSTALL += " iptables "
#IMAGE_INSTALL += " dobby "
IMAGE_INSTALL += "phosphor-state-manager"
IMAGE_INSTALL += "host-reboot"

# Uncomment to enable AST2600 HACE/ACRY
# IMAGE_INSTALL += " openssl-engines "

# DL_DIR = "/work/obmc_downloads"
# SSTATE_DIR = "/work/sstate-dir"

# See https://st.yandex-team.ru/RNDEMBED-639
#DL_DIR ?= "${TOPDIR}/../downloads"
#BB_GENERATE_MIRROR_TARBALLS ?= "1"
#SOURCE_MIRROR_URL ?= "https://s3.mds.yandex.net/hwrnd-openbmc-cache/downloads/"
#INHERIT += "own-mirrors"

# See https://st.yandex-team.ru/RNDEMBED-639
#SSTATE_DIR ?= "${TOPDIR}/../sstate-cache"
#SSTATE_MIRRORS ?= "file://.* https://s3.mds.yandex.net/hwrnd-openbmc-cache/sstate-cache/PATH;downloadfilename=PATH"

# BB_NO_NETWORK ?= "1"
# BB_FETCH_PREMIRRORONLY ?= "1"
# SSTATE_MIRROR_ALLOW_NETWORK ?= "1"

# export YAV_TOKEN to allow /usr/bin/yav run in environments without proper SSH key (CI)
#export YAV_TOKEN
OBMC_ORG_YAML_SUBDIRS += "com/intel"
```

## meta-fplus/meta-ai1/conf/machine/ai1.conf
```bitbake
KMACHINE = "aspeed"
MACHINE = "ai1"
KERNEL_DEVICETREE = "${KMACHINE}-yandex-${MACHINE}.dtb"

require meta-common/conf/yandex-g5.conf

IMAGE_INSTALL:append = "intel-asd cpld-updater nvme-cooler host-error-monitor crashdump-bin"
```

## meta-fplus/meta-evb2600/conf/machine/evb2600.conf
```bitbake
KMACHINE = "aspeed"
MACHINE = "evb2600"
KERNEL_DEVICETREE = "${KMACHINE}-yandex-${MACHINE}.dtb"

require meta-common/conf/yandex-g6.conf
UBOOT_MACHINE = "yandex_ast2600_defconfig"
UBOOT_DEVICETREE = "yandex-evb2600"

SERIAL_CONSOLES = "115200;ttyS4"

IMAGE_INSTALL:append = " aspeed-app"
```

## meta-fplus/meta-fp01/conf/machine/fp01.conf
```bitbake
KMACHINE = "aspeed"
MACHINE = "fp01"
KERNEL_DEVICETREE = "${KMACHINE}-yandex-${MACHINE}.dtb"

require meta-common/conf/ucode-g5.conf

IMAGE_INSTALL:append = "cpld-updater nvme-cooler crashdump-bin cjson host-error-monitor"

#OBMC_ORG_YAML_SUBDIRS += "com/intel"
#OVERRIDES .= ":intel"
```

## meta-ucode/conf/machine/include/ucode.inc
```bitbake
DISTROOVERRIDES .= ":ucode"

MACHINE_FEATURES += "\
        obmc-bmc-state-mgmt \
        obmc-phosphor-fan-mgmt \
        obmc-phosphor-flash-mgmt \
        "

VIRTUAL-RUNTIME_skeleton_workbook = "${MACHINE}-config"

PREFERRED_PROVIDER_virtual/obmc-chassis-mgmt = "packagegroup-ucode-apps"
PREFERRED_PROVIDER_virtual/obmc-fan-mgmt = "packagegroup-ucode-apps"
PREFERRED_PROVIDER_virtual/obmc-flash-mgmt = "packagegroup-ucode-apps"
PREFERRED_PROVIDER_virtual/obmc-inventory-data ?= "${VIRTUAL-RUNTIME_skeleton_workbook}"
PREFERRED_PROVIDER_virtual/obmc-system-mgmt = "packagegroup-ucode-apps"

# IMAGE_FEATURES:remove = "obmc-ikvm"

SERIAL_CONSOLES:ucode = "115200;ttyS4"
```

## meta-ucode/meta-breath/conf/machine/breath.conf
```bitbake
KMACHINE = "aspeed"
# KERNEL_DEVICETREE = "aspeed/${KMACHINE}-bmc-opp-${MACHINE}.dtb"
KERNEL_DEVICETREE = "aspeed/${MACHINE}-ast2500-evb.dtb"

UBOOT_MACHINE = "evb-ast2500_defconfig"
UBOOT_DEVICETREE = "ast2500-romulus"

require conf/machine/include/ast2500.inc
require conf/machine/include/obmc-bsp-common.inc
require conf/machine/include/openpower.inc
require conf/machine/include/p9.inc

PHOSPHOR_MRW_LICENSE = "Apache-2.0"
PHOSPHOR_MRW_LIC_FILES_CHKSUM = "file://LICENSE;md5=e3fc50a88d0a364313df4b21ef20c29e"
PHOSPHOR_MRW_URI = "git://github.com/open-power/breath-xml;branch=master;protocol=https"
PHOSPHOR_MRW_REV = "14b471fbf37f5fb60261de001df83caf5f96d81f"

PREFERRED_PROVIDER_virtual/openpower-occ-control-config-native = "breath-occ-control-config-native"
PREFERRED_PROVIDER_virtual/phosphor-led-manager-config-native = "breath-led-manager-config-native"
PREFERRED_PROVIDER_virtual/phosphor-logging-callouts = "breath-phosphor-logging-callouts-native"

QB_MACHINE = "-machine romulus-bmc"
QB_MEM = "-m 512"
```

## meta-ucode/meta-dalegibbs/conf/machine/dalegibbs.conf
```bitbake
KMACHINE = "aspeed"
KERNEL_DEVICETREE = "aspeed/${KMACHINE}-bmc-ucode-dalegibbs.dtb"

PREFERRED_PROVIDER_virtual/bootloader = "u-boot-aspeed"
PREFERRED_PROVIDER_u-boot = "u-boot-aspeed"
PREFERRED_PROVIDER_u-boot-fw-utils = "u-boot-fw-utils-aspeed"
UBOOT_MACHINE = "ast_g5_phy_config"
# UBOOT_MACHINE = "evb-ast2500_defconfig"
# UBOOT_DEVICETREE = "ast2500-evb"

require conf/machine/include/ast2500.inc
require conf/machine/include/obmc-bsp-common.inc
require dalegibbs.inc

FLASH_SIZE = "32768"
# FLASH_UBOOT_OFFSET:flash-65536 = "0"
# FLASH_UBOOT_ENV_OFFSET:flash-65536 = "1024"
# FLASH_KERNEL_OFFSET:flash-65536 = "2048"

FLASH_ROFS_OFFSET = "4992"
FLASH_RWFS_OFFSET = "28800"

# # We don't have configuration for these components yet, so remove them.
# PREFERRED_PROVIDER_virtual/obmc-fan-mgmt = "tyan-dummy"
# IMAGE_FEATURES:remove = "obmc-fan-control"
# IMAGE_FEATURES:remove = "obmc-fan-mgmt"
# IMAGE_FEATURES:remove = "obmc-flash-mgmt"

PREFERRED_PROVIDER_virtual/phosphor-led-manager-config-native = "breath-led-manager-config-native"
```
