## meta-aspeed/conf/machine/evb-ast2500.conf
```bitbake
KERNEL_DEVICETREE = "aspeed-ast2500-evb.dtb"
UBOOT_MACHINE = "ast_g5_phy_config"

require conf/machine/include/ast2500.inc

SERIAL_CONSOLES = "115200;ttyS4"
SERIAL_CONSOLES += "115200;ttyS0"
SERIAL_CONSOLES += "115200;ttyS1"
SERIAL_CONSOLES += "115200;ttyS2"
SERIAL_CONSOLES += "115200;ttyS3"
```

## meta-intel-openbmc/meta-openyard/conf/layer.conf
```bitbake
# We have a conf and classes directory, add to BBPATH
BBPATH .= ":${LAYERDIR}"

# We have recipes-* directories, add to BBFILES
BBFILES += "${LAYERDIR}/recipes-*/*/*.bb \
            ${LAYERDIR}/recipes-*/*/*.bbappend"

BBFILE_COLLECTIONS += "openyard"
BBFILE_PATTERN_openyard = ""
BBFILE_PRIORITY_openyard = "5"
LAYERSERIES_COMPAT_openyard = "langdale mickledore"
```

## meta-intel-openbmc/meta-openyard/conf/machine/openyard.conf
```bitbake
KMACHINE = "aspeed"
KERNEL_DEVICETREE = "${KMACHINE}-bmc-intel-openyard.dtb"

require conf/machine/include/ast2600.inc
require conf/machine/include/obmc-bsp-common.inc
require conf/machine/include/intel.inc

UBOOT_MACHINE = "ast2600_openbmc_defconfig"
UBOOT_DEVICETREE = "ast2600-intel"
SPL_BINARY = "spl/u-boot-spl.bin"
SOCSEC_SIGN_ENABLE = "0"

SERIAL_CONSOLES = "115200;ttyS4"

FLASH_SIZE = "32768"

VIRTUAL-RUNTIME_skeleton_workbook = "${MACHINE}-config"
```

## meta-openyard/conf/layer.conf
```bitbake
# We have a conf and classes directory, add to BBPATH
BBPATH .= ":${LAYERDIR}"

# We have recipes-* directories, add to BBFILES
BBFILES += "${LAYERDIR}/meta-common/recipes-*/*/*.bb \
            ${LAYERDIR}/meta-common/recipes-*/*/*.bbappend"

BBFILE_COLLECTIONS += "openyard"
BBFILE_PATTERN_openyard = "^${LAYERDIR}/"
LAYERVERSION_openyard = "1"
LAYERSERIES_COMPAT_openyard = "langdale mickledore"
LAYERDEPENDS_openyard = "phosphor-layer"
```

## meta-openyard/conf/machine/include/openyard.inc
```bitbake
MACHINE_FEATURES += "\
        obmc-bmc-state-mgmt \
        obmc-phosphor-fan-mgmt \
        obmc-phosphor-flash-mgmt \
        "

VIRTUAL-RUNTIME_skeleton_workbook = "${MACHINE}-config"

PREFERRED_PROVIDER_virtual/obmc-chassis-mgmt = "packagegroup-openyard-apps"
PREFERRED_PROVIDER_virtual/obmc-fan-mgmt = "packagegroup-openyard-apps"
PREFERRED_PROVIDER_virtual/obmc-flash-mgmt = "packagegroup-openyard-apps"
PREFERRED_PROVIDER_virtual/obmc-system-mgmt = "packagegroup-openyard-apps"
PREFERRED_PROVIDER_virtual/obmc-inventory-data ?= "${VIRTUAL-RUNTIME_skeleton_workbook}"
PREFERRED_PROVIDER_virtual/obmc-host-ipmi-hw = "phosphor-ipmi-kcs"

OVERRIDES .= ":openyard"
```

## meta-openyard/meta-dev2600/conf/layer.conf
```bitbake
# We have a conf and classes directory, add to BBPATH
BBPATH .= ":${LAYERDIR}"

# We have recipes-* directories, add to BBFILES
BBFILES += "${LAYERDIR}/recipes-*/*/*.bb \
            ${LAYERDIR}/recipes-*/*/*.bbappend"

BBFILE_COLLECTIONS += "dev2600"
BBFILE_PATTERN_dev2600 = ""
BBFILE_PRIORITY_dev2600 = "5"
LAYERSERIES_COMPAT_dev2600 = "langdale mickledore"
```

## vscode-bitbake-build/conf/bblayers.conf
```bitbake
# POKY_BBLAYERS_CONF_VERSION is increased each time build/conf/bblayers.conf
# changes incompatibly
POKY_BBLAYERS_CONF_VERSION = "2"

BBPATH = "${TOPDIR}"
BBFILES ?= ""

BBLAYERS ?= " \
  /home/openyard/openyard/openbmc_rev2/openbmc/meta \
  /home/openyard/openyard/openbmc_rev2/openbmc/meta-poky \
  /home/openyard/openyard/openbmc_rev2/openbmc/meta-yocto-bsp \
  "
```
